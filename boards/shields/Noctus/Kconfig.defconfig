## boards/shields/Noctus/Kconfig.defconfig
```kconfig
if SHIELD_NOCTUS_R

config ZMK_KEYBOARD_NAME
    default "Noctus_R"

config ZMK_SPLIT
    default y

config ZMK_SPLIT_ROLE_CENTRAL
    default y
    
config ZMK_POINTING
    default y

config PAW3222
    default y
    
endif

if SHIELD_NOCTUS_L

config ZMK_KEYBOARD_NAME
    default "Noctus_L"

config ZMK_SPLIT
    default y

endif
```

## boards/shields/Noctus/Kconfig.shield
```kconfig
config SHIELD_NOCTUS_R
    def_bool $(shields_list_contains,Noctus_R)

config SHIELD_NOCTUS_L
    def_bool $(shields_list_contains,Noctus_L)
```

## config/west.yml
```yaml
manifest:
  remotes:
    - name: zmkfirmware 
      url-base: https://github.com/zmkfirmware
    - name: MeowCatpawkittie
      url-base: https://github.com/MeowCatpawkittie
    - name: caksoylar
      url-base: https://github.com/caksoylar
    - name: petejohanson
      url-base: https://github.com/petejohanson
    - name: sekigon-gonnoc
      url-base: https://github.com/sekigon-gonnoc
  projects:
    - name: zmk
      remote: zmkfirmware
      revision: v0.3
      import: app/west.yml
    - name: cirque-input-module
      remote: petejohanson
      revision: main
    - name: zmk-driver-paw3222
      remote: sekigon-gonnoc
      revision: main
    - name: zmk-rgbled-widget
      remote: caksoylar
      revision: main
  self:
    path: config
```
